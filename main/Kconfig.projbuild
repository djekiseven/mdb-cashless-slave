## main/Kconfig.projbuild
```kconfig
menu "MDB Cashless Configuration"

    config MDB_RX_PIN
        int "MDB RX GPIO number"
        range 0 48
        default 16
        help
            GPIO pin для приема данных от MDB мастера (VMC).
            
            Некоторые GPIO используются для других целей (подключение флеш-памяти и т.д.) и не могут быть использованы.
            
            GPIO 35-39 только для входа, что подходит для RX пина.

    config MDB_TX_PIN
        int "MDB TX GPIO number"
        range 0 48
        default 17
        help
            GPIO pin для передачи данных на MDB мастер (VMC).
            
            Некоторые GPIO используются для других целей (подключение флеш-памяти и т.д.) и не могут быть использованы.
            
            GPIO 35-39 только для входа, поэтому не могут быть использованы как TX.

    config MDB_LED_PIN
        int "MDB LED GPIO number"
        range 0 48
        default 2
        help
            GPIO pin для индикации состояния MDB.
            
            Некоторые GPIO используются для других целей (подключение флеш-памяти и т.д.) и не могут быть использованы.
            
            GPIO 35-39 только для входа, поэтому не могут быть использованы для LED.

endmenu
```

## mdb-slave-esp32s3/sdkconfig.defaults
```kconfig
# ESP32 WROVER Configuration
CONFIG_IDF_TARGET="esp32"
CONFIG_ESP32_DEFAULT_CPU_FREQ_240=y
CONFIG_ESP32_DEFAULT_CPU_FREQ_MHZ=240
CONFIG_ESPTOOLPY_FLASHMODE_DIO=y
CONFIG_ESPTOOLPY_FLASHFREQ_40M=y
CONFIG_ESPTOOLPY_FLASHSIZE_4MB=y
CONFIG_SPIRAM_SUPPORT=y
CONFIG_SPIRAM_TYPE_AUTO=y
CONFIG_SPIRAM_SIZE=-1
CONFIG_SPIRAM_SPEED_40M=y
CONFIG_SPIRAM_BOOT_INIT=y
CONFIG_SPIRAM_USE_MALLOC=y
CONFIG_SPIRAM_MEMTEST=y
CONFIG_SPIRAM_MALLOC_ALWAYSINTERNAL=16384
CONFIG_SPIRAM_TRY_ALLOCATE_WIFI_LWIP=y
CONFIG_SPIRAM_MALLOC_RESERVE_INTERNAL=32768
```

## sdkconfig.defaults
```kconfig
# Default sdkconfig values for ESP-IDF 5.5
CONFIG_BLINK_GPIO=2
CONFIG_ESP_SYSTEM_PANIC_PRINT_REBOOT=y
CONFIG_ESP_CONSOLE_UART_DEFAULT=y

# Disable Task Watchdog Timer
CONFIG_ESP_TASK_WDT=n
CONFIG_ESP_TASK_WDT_EN=n
CONFIG_ESP_TASK_WDT_INIT=n
```
